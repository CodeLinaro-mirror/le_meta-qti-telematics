## conf/distro/qcom-telematics.conf
```bitbake
require conf/distro/include/qcom-telematics.inc
require conf/distro/include/user_permissions.inc

DISTRO_NAME = "${@oe.utils.conditional('DEBUG_BUILD','1','QTI Linux Telematics distro with debug capabilities.','QTI Linux Telematics distro targeting performance builds.',d)}"
```

## conf/machine/sa535m-emmc.conf
```bitbake
#@TYPE: Machine
#@NAME: SA525M-EMMC
#@DESCRIPTION: Machine configuration for SA525M EMMC

require conf/machine/include/qcom-sa535m.inc

# MACHINE_FEATURES ##
MACHINE_FEATURES += "emmc-boot"


KERNEL_DEVICETREE:pn-linux-qcom-custom = " \
                      qcom/sa535m-emmc-tdp.dtb \
                      "

# Additional dtbo to overylay on top of kernel devicetree files
KERNEL_TECH_DTBOS[sa535m-emmc-tdp] = " \
                      sa535m-audio.dtbo \
                      sa535m-qti-can.dtbo \
                      sa535m-cnss.dtbo \
                      sa535m-bt.dtbo \
                      ${@bb.utils.contains('MACHINE_FEATURES', 'qti-isim', 'sa535m-isim.dtbo', '', d)} \
                      "

# Recipe providers of above dtbo files.
KERNEL_TECH_DTBO_PROVIDERS = "\
                      audiodevicetree \
                      can-kernel-devicetree \
                      wlan-devicetree \
                      bt-devicetree \
                      ${@bb.utils.contains('MACHINE_FEATURES', 'qti-isim', 'isim-devicetree', '', d)} \
                      "

KERNEL_CONFIG = "qcom_telematics_base_defconfig"
KERNEL_CONFIG_FRAGMENTS = "${S}/arch/arm64/configs/vendor/sa535m.config"
KERNEL_CONFIG_FRAGMENTS:append = " ${@oe.utils.vartrue('DEBUG_BUILD', '${S}/arch/arm64/configs/vendor/sa535m-debug.config', '', d)}"

# Default Image names
BOOTIMAGE_TARGET   ?= "boot.img"
SYSTEMIMAGE_TARGET ?= "sysfs.img"

# Sizes for EXT4 (in bytes)
SYSTEM_SIZE_EXT4  = "471859200"
USERDATA_SIZE_EXT4 = "251658240"
CACHE_SIZE_EXT4 = "26214400"
SYSTEMRW_SIZE_EXT4 = "8192000"
PERSIST_SIZE_EXT4  = "6291456"
ISIM_SIZE_EXT4 = "83886080"
PAGE_SIZE ?= '4096'

SLOT_A_SUFFIX = ""

# Formats of root filesystem images
IMAGE_FSTYPES += "ext4"
MACHINE_FSCONFIG_CONF = "sa535m-emmc-fsconfig.conf"

# File indicating firmware residing places on device.
MACHINE_FILESMAP_CONF = "sa535m-emmc-filesmap"

MACHINE_PARTITION_CONF = "sa535m-partition.conf"
```

## conf/machine/sa535m.conf
```bitbake
#@TYPE: Machine
#@NAME: sa535m
#@DESCRIPTION: Machine configuration for Qualcomm SA535M chipset.

require conf/machine/include/qcom-sa535m.inc
MACHINE_FEATURES += "nand-boot"

KERNEL_DEVICETREE:pn-linux-qcom-custom = " \
                      qcom/sa535m-nand-tdp.dtb \
                      "

# Additional dtbo to overylay on top of kernel devicetree files
KERNEL_TECH_DTBOS[sa535m-nand-tdp] = " \
                      sa535m-audio.dtbo \
                      sa535m-qti-can.dtbo \
                      sa535m-cnss.dtbo \
                      sa535m-bt.dtbo \
                      sa535m-eth.dtbo \
                      ${@bb.utils.contains('MACHINE_FEATURES', 'qti-isim', 'sa535m-isim.dtbo', '', d)} \
                      "

# Recipe providers of above dtbo files.
KERNEL_TECH_DTBO_PROVIDERS = " \
                      audiodevicetree \
                      can-kernel-devicetree \
                      wlan-devicetree \
                      bt-devicetree \
                      data-devicetree \
                      ${@bb.utils.contains('MACHINE_FEATURES', 'qti-isim', 'isim-devicetree', '', d)} \
                      "

# sa535m does not support audio/cnss/bt dtbos
KERNEL_TECH_DTBOS[sa535m-nand-tdp] = " \
                      sa535m-qti-can.dtbo \
                      ${@bb.utils.contains('MACHINE_FEATURES', 'qti-isim', 'sa535m-isim.dtbo', '', d)} \
                      "
KERNEL_TECH_DTBO_PROVIDERS = " \
                      can-kernel-devicetree \
                      ${@bb.utils.contains('MACHINE_FEATURES', 'qti-isim', 'isim-devicetree', '', d)} \
                      "

KERNEL_CONFIG = "qcom_telematics_base_defconfig"
KERNEL_CONFIG_FRAGMENTS = "${S}/arch/arm64/configs/vendor/sa535m.config"
KERNEL_CONFIG_FRAGMENTS:append = " ${@oe.utils.vartrue('DEBUG_BUILD', '${S}/arch/arm64/configs/vendor/sa535m-debug.config', '', d)}"

# Default Image names
BOOTIMAGE_TARGET   ?= "boot.img"
SYSTEMIMAGE_TARGET ?= "sysfs.ubi"

# Formats of root filesystem images
IMAGE_FSTYPES += "ubi"

# Sizes for UBI volumes
SYSTEM_VOLUME_SIZE = "150MiB"
CACHE_VOLUME_SIZE    = "6MiB"
SYSTEMRW_VOLUME_SIZE = "6MiB"
PERSIST_VOLUME_SIZE  = "6MiB"
ISIM_VOLUME_SIZE = "80MiB"

# UBI arguments
PAGE_SIZE ?= '4096'
UBINIZE_ARGS = "-m 4096 -p 256KiB -s 4096"
MKUBIFS_ARGS = "-m 4096 -e 253952 -c 2146 -F"
MKUBIFS_USERFS_ARGS = "-m 4096 -e 253952 -c 6144 -F"

# Sizes for UBI squashfs volumes
SYSTEM_SQUASHFS_VOLUME_SIZE = "${@bb.utils.contains('DEBUG_BUILD', '1', '90MiB', '85MiB', d)}"
MODEM_SQUASHFS_VOLUME_SIZE = "125MiB"
```
